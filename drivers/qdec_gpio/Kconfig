## drivers/qdec_gpio/Kconfig
```kconfig
menu "GPIO quadrature decoder"
config QDEC_GPIO
    bool "Enable gpio quadrature decoder"
    depends on GPIO && SENSOR


if QDEC_GPIO

config QDEC_GPIO_CUMULATIVE
    bool "Cumulative rotation"
    help
       "If this is disabled, the rotation output will be delta from previous sample fetch "

endif
endmenu

module = QDEC_GPIO_DRIVER
module-str = qdec gpio driver
source "subsys/logging/Kconfig.template.log_config"
```

## project/boards/adafruit_itsybitsy_nrf52840/Kconfig.defconfig
```kconfig
# Adafruit ItsyBitsy nRF52840 Express board configuration

# Copyright (c) 2022 Embla Flatlandsmo
# SPDX-License-Identifier: Apache-2.0

if BOARD_ADAFRUIT_ITSYBITSY_NRF52840

config BOARD
	default "adafruit_itsybitsy_nrf52840"

config BT_CTLR
	default BT

endif # BOARD_ADAFRUIT_ITSYBITSY_NRF52840
```

## project/src/events/Kconfig
```kconfig
#
# Copyright (c) 2021 Nordic Semiconductor
#
# SPDX-License-Identifier: LicenseRef-Nordic-5-Clause
#

menuconfig EVENTS
	bool "Event options"
	default y

if EVENTS

# config APP_EVENTS_LOG
# 	bool "Enable logging for application module events"
# 	default y

config QDEC_EVENTS_LOG
	bool "Enable logging for BLE module events"
	default y

if NRF_PROFILER

choice
	prompt "Event type format for nrf_profiler"
	default NRF_PROFILER_EVENT_TYPE_INT

config NRF_PROFILER_EVENT_TYPE_STRING
	bool "Event type as string"

config NRF_PROFILER_EVENT_TYPE_INT
	bool "Event type as integer"

endchoice

endif # NRF_PROFILER

endif # EVENTS
```

## project/src/modules/Kconfig.app_module
```kconfig
# Copyright (c) 2021 Nordic Semiconductor
#
# SPDX-License-Identifier: LicenseRef-Nordic-5-Clause
#

menu "Application control module"

config APP_CYLINDER_DIAMETER_MM
    int "Diameter of cylinder to which encoder is attached"
    default 79

config APP_WHEEL_SPEED_LIMIT_MM_PER_SEC
    int "Maximum speed of an individual wheelchair wheel"
    default 500

endmenu
```

## project/src/modules/Kconfig.bluetooth_module
```kconfig
#
# Copyright (c) 2021 Nordic Semiconductor
#
# SPDX-License-Identifier: LicenseRef-Nordic-5-Clause
#

menuconfig BLE_MODULE
	bool "BLE module"
	default y

if BLE_MODULE

config BLE_THREAD_STACK_SIZE
	int "BLE module thread stack size"
	default 1280


endif # BLE_MODULE

module = BLE_MODULE
module-str = BLE module
source "subsys/logging/Kconfig.template.log_config"
```

## project/src/modules/Kconfig.encoder_module
```kconfig
menuconfig ENCODER_MODULE
	bool "Module for encoder signals"
	default y

if ENCODER_MODULE

config ENCODER_TIMEOUT_DURATION_MSEC
	int "Milliseconds elapsed before 0 is output in HID report"
	default 500

config ENCODER_DELTA_TIME_MSEC
	int "Measuring interval in milliseconds. Used to deduct speed from encoder travel."
	default 50
	help
		"Larger values means there is less susceptibility 
		to noise but the system might not pick up actual readings"

config ENCODER_MOVING_AVERAGE_ALPHA
	int "Alpha for moving average filter. Min 0, max 1000"
	default 200

config ENCODER_SIMULATE_INPUT
	bool "Simulates inputs in the case of no encoders being available"

if ENCODER_SIMULATE_INPUT

config ENCODER_SIMULATE_INPUT_INTERVAL
	int "Number of time intervals between min and max input values"
	default 10
	help
	  "To find the time in msec, multiply this value by ENCODER_DELTA_TIME_MSEC"
endif # ENCODER_SIMULATE_INPUT

endif # ENCODER_MODULE

module = ENCODER_MODULE
module-str = ENCODER module
source "subsys/logging/Kconfig.template.log_config"
```

## project/src/modules/Kconfig.hid_module
```kconfig
#
# Copyright (c) 2021 Nordic Semiconductor
#
# SPDX-License-Identifier: LicenseRef-Nordic-5-Clause
#

menuconfig HID_MODULE
	bool "HID module"
	default y

if HID_MODULE

config HID_MODULE_THREAD_STACK_SIZE
	int "HID module thread stack size"
	default 1280

choice 
	prompt "HID Controller Output configuration"

config HID_MODULE_CONTROLLER_OUTPUT_A
	bool "Avg speed on left joystick y-axis, speed difference on left joystick x-axis"

config HID_MODULE_CONTROLLER_OUTPUT_B
	bool "Avg speed on left joystick y-axis, speed difference on right joystick x-axis"

endchoice

config HID_MODULE_MIN_OUTPUT_SPEED_MM_PER_SEC
	int "Translational speed that maps to no output in HID report"
	default 10
    help 
        "Uses millimeter per second to get a finer resolution"

config HID_MODULE_MAX_OUTPUT_SPEED_MM_PER_SEC
	int "Translational speed that maps to saturation and max output in HID report"
	default 3500
    help
        "Uses millimeter per second to get a finer resolution"

config HID_MODULE_MIN_OUTPUT_TURN_RATE_DEG_PER_SEC
    int "Minimum speed difference between wheels which leads to no output in HID report"
    default 5

config HID_MODULE_MAX_OUTPUT_TURN_RATE_DEG_PER_SEC
    int "The turning rate which leads to saturation and max output in HID report"
    default 400

config HID_MODULE_LOG_FOR_PLOT
	bool "Log HID outputs for plotting purposes"
endif # HID_MODULE

module = HID_MODULE
module-str = HID module
source "subsys/logging/Kconfig.template.log_config"
```

## project/src/modules/Kconfig.qdec_module
```kconfig
menuconfig QDEC_MODULE
	bool "Quadrature decoder module"
	default y

if QDEC_MODULE

config QDEC_TIMEOUT_DURATION_MSEC
	int "Milliseconds elapsed before 0 is output in HID report"
	default 500

config QDEC_MINIMUM_DELTA_TIME_MSEC
	int "Minimum milliseconds required for a encoder update to be valid"
	default 10
	help
		"Larger values means there is less susceptibility 
		to noise but the system might not pick up actual readings"

config QDEC_VELOCITY_LOW_PASS_FILTER_COEFFICIENT
	int "Alpha for moving average filter. Min 0, max 1000"
	default 800

endif # QDEC_MODULE

module = QDEC_MODULE
module-str = QDEC module
source "subsys/logging/Kconfig.template.log_config"
```

## qdec/drivers/qdec_gpio/Kconfig
```kconfig
menu "GPIO quadrature decoder"
config QDEC_GPIO
    bool "Enable gpio quadrature decoder"
    depends on GPIO
endmenu

if QDEC_GPIO

config QDEC_GPIO_CUMULATIVE
    bool "Cumulative rotation"
    help
       "If this is disabled, the rotation output will be delta from previous sample fetch "

endif

module = QDEC_GPIO_DRIVER
module-str = qdec gpio driver
source "subsys/logging/Kconfig.template.log_config"
```

## src/modules/Kconfig.app_module
```kconfig
# Copyright (c) 2021 Nordic Semiconductor
#
# SPDX-License-Identifier: LicenseRef-Nordic-5-Clause
#

menu "Application control module"

config APP_CYLINDER_DIAMETER_MM
    int "Diameter of cylinder to which encoder is attached"
    default 79

config APP_INTER_WHEEL_DISTANCE_MM
    int "Distance between the wheels of the wheelchair"
    default 620
endmenu
```

## src/modules/Kconfig.led_module
```kconfig
menuconfig LED_MODULE
	bool "LED module"
	default n
    depends on APA102_STRIP && LED_STRIP && SPI

if LED_MODULE

config LED_MODULE_THREAD_STACK_SIZE
	int "LED module thread stack size"
	default 1280

config LED_MODULE_BLINK_THREAD_STACK_SIZE
    int "LED blink thread stack size"
    default 512

config LED_MODULE_BLINK_DURATION_SHORT_MSEC
	int "Led blinking duraction short"
	default 200

config LED_MODULE_BLINK_DURATION_MEDIUM_MSEC
	int "Led blinking duraction medium"
	default 500

config LED_MODULE_BLINK_DURATION_LONG_MSEC
	int "Led blinking duraction short"
	default 1000
endif # LED_MODULE

module = LED_MODULE
module-str = LED module
source "subsys/logging/Kconfig.template.log_config"
```

## west.yml
```yaml
manifest:
  version: "0.10"

  defaults:
    revision: main

  remotes:
    - name: nrfconnect
      url-base: https://github.com/nrfconnect/

  projects:
    - name: sdk-nrf
      remote: nrfconnect
      path: nrf
      revision: v2.1.2
      import: true
      
  self:
    path: wheelchair-ergometer-game-controller
```
