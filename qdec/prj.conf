## CMakeLists.txt
```
#
# Copyright (c) 2021 Nordic Semiconductor ASA
#
# SPDX-License-Identifier: LicenseRef-Nordic-5-Clause
#

cmake_minimum_required(VERSION 3.20.0)

if (NOT CMAKE_BUILD_TYPE)
  set(CMAKE_BUILD_TYPE ZDebug)
endif()

list(APPEND BOARD_ROOT ${CMAKE_CURRENT_SOURCE_DIR})

set(CMAKE_EXPORT_COMPILE_COMMANDS ON)

set(BOARD nrf52840dk_nrf52840)
find_package(Zephyr REQUIRED HINTS $ENV{ZEPHYR_BASE})
project("qdec-gpio")

# NORDIC SDK APP START
target_sources(app PRIVATE 
  src/main.c
)
# NORDIC SDK APP END


# Include application events and configuration headers
zephyr_library_include_directories(
  src/events
  src/util
  )

# Include source directory
target_include_directories(app PRIVATE src)

# Application directories
add_subdirectory(src/modules)
add_subdirectory(src/events)
add_subdirectory(drivers)
```

## Kconfig
```
menu "qdec_sample"
rsource "drivers/Kconfig"
rsource "src/modules/Kconfig.modules_common"
rsource "src/modules/Kconfig.qdec_module"
rsource "src/events/Kconfig"
endmenu

menu "Zephyr Kernel"
source "Kconfig.zephyr"
endmenu

module = APPLICATION_MODULE
module-str = application
source "subsys/logging/Kconfig.template.log_config"
```

## prj.conf
```kconfig
# General config
CONFIG_NEWLIB_LIBC=y
CONFIG_NEWLIB_LIBC_FLOAT_PRINTF=y
CONFIG_ASSERT=y
CONFIG_REBOOT=y
CONFIG_FPU=y
CONFIG_GPIO=y

CONFIG_HEAP_MEM_POOL_SIZE=16384
CONFIG_MAIN_STACK_SIZE=4096

CONFIG_DEBUG=y

# Necessary for QDEC
CONFIG_GPIO=y
CONFIG_SENSOR=y
CONFIG_QDEC_GPIO=y
CONFIG_QDEC_GPIO_CUMULATIVE=n
# Logger configuration
CONFIG_LOG=y
CONFIG_LOG_MODE_DEFERRED=y
# CONFIG_LOG_DEFAULT_LEVEL=4
# CONFIG_LOG_STRDUP_BUF_COUNT=20
# CONFIG_LOG_STRDUP_MAX_STRING=128
CONFIG_SENSOR_LOG_LEVEL_DBG=y
CONFIG_QDEC_MODULE_LOG_LEVEL_DBG=y
CONFIG_QDEC_EVENTS_LOG=y
CONFIG_QDEC_VELOCITY_LOW_PASS_FILTER_COEFFICIENT=200


CONFIG_APPLICATION_MODULE_LOG_LEVEL_DBG=y
# Application Event Manager
CONFIG_APP_EVENT_MANAGER=y
CONFIG_APP_EVENT_MANAGER_LOG_EVENT_TYPE=y
# CAF - Common Application Framework
CONFIG_CAF=y
CONFIG_CAF_INIT_LOG_KEEP_ALIVE_EVENTS=n
```

## boards/nrf52840dk_nrf52840.overlay
```dts
/* SPDX-License-Identifier: Apache-2.0 */

/ {
	qdecA: qdecA {
		compatible = "nordic,qdec-gpio";
		status = "okay";
		label = "quadrature encoder A";
		line-a-gpios = <&gpio0 26 0>;
		line-b-gpios = <&gpio0 27 0>;
		ticks-per-rotation = <8>;
	};
};
```

## src/main.c
```c
/*
 * Copyright (c) 2019 Nordic Semiconductor ASA
 *
 * SPDX-License-Identifier: LicenseRef-Nordic-5-Clause
 */

#include <app_event_manager.h>
#include <zephyr/logging/log.h>

#define MODULE main
#include <caf/events/module_state_event.h>

LOG_MODULE_REGISTER(MODULE);

void main(void)
{
	if (app_event_manager_init()) {
		LOG_ERR("Application Event Manager not initialized");
	} else {
		module_set_state(MODULE_STATE_READY);
	}
}
```
