/* SPDX-License-Identifier: Apache-2.0 */

&spi1 {
	status="disabled";
};
/ {
	qdecA: qdecA {
		compatible = "nordic,qdec-gpio";
		status = "okay";
		label = "quadrature encoder A";
		/* Right side encoder */
		/* line-a: Back
		line-b: Front */
		line-a-gpios = <&gpio0 13 (GPIO_ACTIVE_LOW) >; /* SCK */
		line-b-gpios = <&gpio0 15 (GPIO_ACTIVE_LOW) >; /* MO */
		/* use SPI pins because they are HS on the right side... */
		ticks-per-rotation = <16>;
	};

	qdecB: qdecB {
		compatible = "nordic,qdec-gpio";
		status = "okay";
		label = "quadrature encoder B";
		/* Left Side Encoder */
		/* line-a: Back */
		/* line-b: Front */
		line-a-gpios = <&gpio0 12 (GPIO_ACTIVE_LOW)>; /* D13 */
		line-b-gpios = <&gpio0 11 (GPIO_ACTIVE_LOW)>; /* D12 */
		ticks-per-rotation = <16>;
	};

};